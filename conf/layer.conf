## conf/layer.conf
```bitbake
BBPATH .= ":${LAYERDIR}"

BBFILES += " \
    ${LAYERDIR}/recipes-*/*/*.bb \
    ${LAYERDIR}/recipes-*/*/*.bbappend \
"

BBFILE_COLLECTIONS += "meta-acadia"
BBFILE_PATTERN_meta-acadia = "^${LAYERDIR}/"
BBFILE_PRIORITY_meta-acadia = "10"

LAYERDEPENDS_meta-acadia = "core raspberrypi"
LAYERSERIES_COMPAT_meta-acadia = "scarthgap"
```
